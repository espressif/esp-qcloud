## Kconfig.projbuild
```kconfig
menu "ESP QCloud Configuration"
    config QCLOUD_MASS_MANUFACTURE
        bool "ESP QCloud Mass Manufacture"
        default n
        help
            Write authentication information through flash tool

        config QCLOUD_FACTRY_PARTITION_NAME
            depends on QCLOUD_MASS_MANUFACTURE
            string "ESP QCloud Factory Partition Name"
            default "fctry"
            help
                Factory NVS Partition name which will have the QCloud IOTHUB connectivity credentials.

        config QCLOUD_FACTRY_PARTITION_NAMESPACE
            depends on QCLOUD_MASS_MANUFACTURE
            string "ESP QCloud Factory Partition NVS Namespace"
            default "qcloud-key"
            help
                Factory NVS Partition name which will have the QCloud IOTHUB connectivity credentials.

        choice QCLOUD_DEVICE_AUTH_MODE
            depends on !QCLOUD_MASS_MANUFACTURE
            prompt "QCloud Authentication mode"
            default AUTH_MODE_KEY
            help
                QCloud Authentication mode.

            config AUTH_MODE_KEY
                bool "KEY"
            config AUTH_MODE_CERT
                bool "CERT"
        endchoice

        config QCLOUD_PRODUCT_ID
            depends on !QCLOUD_MASS_MANUFACTURE
            string "Product ID"
            default "PRODUCT_ID"
            help
                Set the Product ID.
            
        config QCLOUD_DEVICE_NAME
            depends on !QCLOUD_MASS_MANUFACTURE
            string "Device Name"
            default "DEVICE_NAME"
            help
                Set the Device Name.
            
        config QCLOUD_DEVICE_SECRET
            depends on AUTH_MODE_KEY
            string "Device Secret"
            default "DEVICE_SECRET"
            help
                Set the Device Secret.

    menu "ESP QCloud OTA Config"
        config QCLOUD_SKIP_VERSION_CHECK
            bool "Skip firmware version check"
            default y
            help
                This allows you to skip the firmware version check. Useful during development,
                but not for production.

        config QCLOUD_SKIP_PROJECT_NAME_CHECK
            bool "Skip project name check"
            default n
            help
                This allows you to skip the project name check.

        config QCLOUD_USE_HTTPS_UPDATA
            bool "Use https updata"
            default n
            help
                This allows you to use https updata firmware.
    endmenu

    menu "ESP QCloud utils"
        choice QCLOUD_MEM_ALLOCATION_LOCATION
            prompt "The memory location allocated by QCLOUD_MALLOC QCLOUD_CALLOC and QCLOUD_REALLOC"
            help 
                choice where to allocate memory, can be SPIRAM or default

            config QCLOUD_MEM_ALLOCATION_DEFAULT
                bool "default allocation strategy"
            config QCLOUD_MEM_ALLOCATION_SPIRAM
                depends on ESP32S2_SPIRAM_SUPPORT || ESP32_SPIRAM_SUPPORT
                bool "allocate memory in SPIRAM"
        endchoice
            
        config QCLOUD_MEM_DEBUG
            bool "Memory debug"
            default y
            help
                Memory debug.

        config QCLOUD_MEM_DBG_INFO_MAX
            depends on QCLOUD_MEM_DEBUG
            int "QCloud Memory debug record max."
            default 128
            help
                Config QCloud Memory debug record max.

        config QCLOUD_NVS_NAMESPACE
            string "Namespace where data is stored in NVS"
            default "qcloud_app"
            help
                Namespace where data is stored in NVS.

        config QCLOUD_REBOOT_UNBROKEN_INTERVAL_TIMEOUT
            int "Continuous reboot interval(ms)"
            default 3000
            help
            Continuous reboot interval.

        config QCLOUD_REBOOT_UNBROKEN_FALLBACK_COUNT
            int "Continuous restart triggers version rollback"
            default 30
            help
            Continuous restart triggers version rollback.
    endmenu

    menu "ESP QCloud Log Config"
        config QCLOUD_LOG_PARTITION_LABEL_DATA
            string "Store log info partition label"
            default "log_info"
            help
                Store log info partition label.
            
        config QCLOUD_LOG_PARTITION_LABEL_NVS
            string "Store log status partition label"
            default "log_status"
            help
                Store log status partition label.

        config QCLOUD_LOG_FILE_MAX_SIZE
            int "Output the save the file size of the log"
            range 8196 131072
            default 65536
            help
                Output the Save the file size of the log

        config QCLOUD_LOG_PARTITION_OFFSET
            int "Offset of the log information partition"
            range 0 524288
            default 0
            help
                Offset of the log information partition

        config QCLOUD_LOG_PRINTF_ENABLE
            bool "Output the `printf` information of the QCloud module"
            default n
            help
                Output the `printf` information of the QCloud module
    endmenu

    choice QCLOUD_CONSOLE_UART_NUM
        prompt "UART for console input"
        default QCLOUD_CONSOLE_UART_NUM_0
        help
            UART to be selected for serial console.

        config QCLOUD_CONSOLE_UART_NUM_0
            bool "UART0"
        config QCLOUD_CONSOLE_UART_NUM_1
            bool "UART1"
    endchoice

    config QCLOUD_CONSOLE_UART_NUM
        int
        default 0 if QCLOUD_CONSOLE_UART_NUM_0
        default 1 if QCLOUD_CONSOLE_UART_NUM_1

endmenu
```

## examples/led_light/main/Kconfig.projbuild
```kconfig
menu "ESP QCloud Example Configuration"
    menu "Light development board selection "
        choice LIGHTBULB_DEMO_DRIVER_SELECT
                bool "Demo select"
                default LIGHTBULB_DEMO_DRIVER_SELECT_WS2812 if IDF_TARGET_ESP32C3 || IDF_TARGET_ESP32S2 || IDF_TARGET_ESP32S3 || IDF_TARGET_ESP32H2
                default LIGHTBULB_DEMO_DRIVER_SELECT_PWM
                help
                    Select the driver type you want to demonstrate

                config LIGHTBULB_DEMO_DRIVER_SELECT_SM2135E
                    bool "Demo SM2135E"
                config LIGHTBULB_DEMO_DRIVER_SELECT_WS2812
                    bool "Demo WS2812"
                config LIGHTBULB_DEMO_DRIVER_SELECT_PWM
                    bool "Demo PWM"
        endchoice

        config WS2812_LED_GPIO
            int "WS2812 LED GPIO"
            default 8 if IDF_TARGET_ESP32C3 || IDF_TARGET_ESP32H2
            default 18 if IDF_TARGET_ESP32S2
            default 48 if IDF_TARGET_ESP32S3
            default 4 if IDF_TARGET_ESP32C2
            default 18
            depends on LIGHTBULB_DEMO_DRIVER_SELECT_WS2812
            help
                Set the WS2812 RGB LED GPIO.

        config WS2812_LED_NUM
            int "WS2812 LED NUM"
            default 1
            depends on LIGHTBULB_DEMO_DRIVER_SELECT_WS2812
            help
                Set the WS2812 LED NUM.

        config PWM_FREQ_HZ
            int "PWM Frequency (hz)"
            default 4000
            range 2000 5000
            depends on LIGHTBULB_DEMO_DRIVER_SELECT_PWM
            help
                Set the PWM Frequency (hz).

        config PWM_RED_GPIO
            int "PWM Red GPIO"
            default 10 if IDF_TARGET_ESP32C3 || IDF_TARGET_ESP32S2
            default 15 if IDF_TARGET_ESP32S3
            default 0 if IDF_TARGET_ESP32C2
            default 23 if IDF_TARGET_ESP32H2
            default 25
            depends on LIGHTBULB_DEMO_DRIVER_SELECT_PWM
            help
                Set the PWM Red LED GPIO.

        config PWM_GREEN_GPIO
            int "PWM Green GPIO"
            default 6 if IDF_TARGET_ESP32C3 || IDF_TARGET_ESP32S2
            default 16 if IDF_TARGET_ESP32S3
            default 1 if IDF_TARGET_ESP32C2
            default 24 if IDF_TARGET_ESP32H2
            default 26
            depends on LIGHTBULB_DEMO_DRIVER_SELECT_PWM
            help
                Set the PWM Green LED GPIO.

        config PWM_BLUE_GPIO
            int "PWM Blue GPIO"
            default 7 if IDF_TARGET_ESP32C3 || IDF_TARGET_ESP32S2
            default 17 if IDF_TARGET_ESP32S3
            default 8 if IDF_TARGET_ESP32C2
            default 25 if IDF_TARGET_ESP32H2
            default 27
            depends on LIGHTBULB_DEMO_DRIVER_SELECT_PWM
            help
                Set the PWM Blue LED GPIO.

        config SM2135E_IIC_CLK_GPIO
            int "SM2135E IIC CLK GPIO"
            default 4
            depends on LIGHTBULB_DEMO_DRIVER_SELECT_SM2135E
            help
                Set the SM2135E CLK GPIO.

        config SM2135E_IIC_SDA_GPIO
            int "SM2135E IIC SDA GPIO"
            default 5
            depends on LIGHTBULB_DEMO_DRIVER_SELECT_SM2135E
            help
                Set the SM2135E SDA GPIO.
    endmenu

menu "Light provisioning network selection"
        config LIGHT_PROVISIONING_SMARTCONFIG
            bool "Enable SmartConfig's smart network configuration method"
            default n
            help
                Enable SmartConfig's smart network configuration method
        
        config LIGHT_PROVISIONING_SOFTAPCONFIG
            bool "Enable SoftAP's network configuration method"
            default y
            help
                "Enable SoftAP's network configuration method"

        config LIGHT_PROVISIONING_BLECONFIG
            depends on QCLOUD_ENABLE_BLECONFIG
            bool "Enable BLE's network configuration method"
            default y
            help
                "Enable BLE's network configuration method"

        config LIGHT_PROVISIONING_SOFTAPCONFIG_SSID
            depends on LIGHT_PROVISIONING_SOFTAPCONFIG
            string "SoftAP ssid"
            default "tcloud_XXX"
            help
                SSID (network name) for the phone to connect to.

        config LIGHT_PROVISIONING_BLECONFIG_NAME
            depends on LIGHT_PROVISIONING_BLECONFIG
            string "BLE name"
            default "Qcloud"
            help
                BLE for the phone to connect to.
    endmenu

    config LIGHT_REBOOT_UNBROKEN_COUNT_RESET
        int "More than this number of continuous uninterrupted restarts triggers a reset of the device"
        range 3 15
        default 5
        help
            Devices without buttons trigger a device reset through continuous restart.

    config LIGHT_DEBUG
        bool "The device will be in debug mode"
        default n
        help
            Debug mode device performance is only used during development.

endmenu
```

## examples/led_light/sdkconfig.defaults
```kconfig
# Override some defaults in mesh application project.

#
# Serial flasher config
#
CONFIG_ESPTOOLPY_FLASHSIZE_4MB=y
CONFIG_ESPTOOLPY_FLASHMODE_QIO=y
CONFIG_ESPTOOLPY_FLASHFREQ_80M=y

#
# Partition Table
#
CONFIG_PARTITION_TABLE_CUSTOM=y

#
# ESP HTTPS OTA
#
CONFIG_OTA_ALLOW_HTTP=y

#
# FreeRTOS
#
CONFIG_FREERTOS_HZ=1000
CONFIG_FREERTOS_UNICORE=y
CONFIG_ESP_TIMER_TASK_STACK_DEPTH=3072
CONFIG_FREERTOS_USE_TRACE_FACILITY=y
CONFIG_FREERTOS_USE_STATS_FORMATTING_FUNCTIONS=y
CONFIG_FREERTOS_VTASKLIST_INCLUDE_COREID=y
CONFIG_FREERTOS_GENERATE_RUN_TIME_STATS=y

#
# ESP32-specific
#
CONFIG_ESP_TASK_WDT_PANIC=y
CONFIG_ESP_TASK_WDT_TIMEOUT_S=10
CONFIG_ESP32_ENABLE_COREDUMP=y
CONFIG_ESP32_ENABLE_COREDUMP_TO_FLASH=y
CONFIG_ESP32_DEFAULT_CPU_FREQ_240=y
CONFIG_ESP32_DEFAULT_CPU_FREQ_MHZ=240

#
# ESP32S2-specific
#
CONFIG_ESP32_WIFI_STATIC_RX_BUFFER_NUM=8
CONFIG_ESP32_WIFI_DYNAMIC_RX_BUFFER_NUM=24
CONFIG_ESP32_WIFI_DYNAMIC_TX_BUFFER_NUM=24
CONFIG_ESP32_WIFI_AMPDU_TX_ENABLED=y
CONFIG_ESP32_WIFI_TX_BA_WIN=16
CONFIG_ESP32_WIFI_AMPDU_RX_ENABLED=y
CONFIG_ESP32_WIFI_RX_BA_WIN=16

CONFIG_LWIP_TCP_SND_BUF_DEFAULT=28000
CONFIG_LWIP_TCP_WND_DEFAULT=28000
CONFIG_LWIP_TCP_RECVMBOX_SIZE=32
CONFIG_LWIP_UDP_RECVMBOX_SIZE=32
CONFIG_LWIP_TCPIP_RECVMBOX_SIZE=32

CONFIG_ESP32S2_DEFAULT_CPU_FREQ_240=y
CONFIG_ESP32S2_DEFAULT_CPU_FREQ_MHZ=240

CONFIG_ESP32S2_INSTRUCTION_CACHE_16KB=y
CONFIG_ESP32S2_INSTRUCTION_CACHE_LINE_16B=y
CONFIG_ESP32S2_INSTRUCTION_CACHE_WRAP=y
```
